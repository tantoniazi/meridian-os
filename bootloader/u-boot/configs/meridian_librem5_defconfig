## bootloader/u-boot/configs/meridian_librem5_defconfig
```kconfig
# Meridian OS - U-Boot Config for Librem 5 (i.MX8MQ)
# Based on mainline U-Boot v2024.01

CONFIG_ARM=y
CONFIG_ARM64=y
CONFIG_TARGET_IMX8MQ=y
CONFIG_SPL=y
CONFIG_SPL_LIBCOMMON_SUPPORT=y
CONFIG_SPL_LIBGENERIC_SUPPORT=y
CONFIG_SPL_MMC_SUPPORT=y
CONFIG_SPL_MMC_WRITE=y
CONFIG_SPL_NAND_SUPPORT=n
CONFIG_SPL_SPI_FLASH_SUPPORT=n
CONFIG_SPL_SPI_SUPPORT=n
CONFIG_SPL_USB_SUPPORT=n
CONFIG_SPL_ENV_SUPPORT=y
CONFIG_SPL_NET_SUPPORT=n

# Console
CONFIG_SYS_CONSOLE_IS_IN_ENV=y
CONFIG_CONS_INDEX=1
CONFIG_BAUDRATE=115200
CONFIG_SYS_NS16550=y
CONFIG_SYS_NS16550_SERIAL=y
CONFIG_SYS_NS16550_REG_SIZE=1
CONFIG_SYS_NS16550_CLK=24000000

# Memory
CONFIG_SYS_SDRAM_BASE=0x40000000
CONFIG_SYS_SDRAM_SIZE=0x80000000

# MMC
CONFIG_MMC=y
CONFIG_MMC_IMX=y
CONFIG_MMC_IMX_DMA=y
CONFIG_MMC_IMX_HS200_SUPPORT=y
CONFIG_MMC_IMX_HS400_SUPPORT=y
CONFIG_SYS_MMC_ENV_PART=0
CONFIG_SYS_MMC_ENV_DEV=0

# USB
CONFIG_USB=y
CONFIG_USB_GADGET=y
CONFIG_USB_GADGET_DOWNLOAD=y
CONFIG_USB_GADGET_MANUFACTURER="Purism"
CONFIG_USB_GADGET_VENDOR_NUM=0x1d6b
CONFIG_USB_GADGET_PRODUCT_NUM=0x0104

# Network
CONFIG_NET=y
CONFIG_NET_RANDOM_ETHADDR=y

# Environment
CONFIG_ENV_IS_IN_MMC=y
CONFIG_SYS_MMC_ENV_DEV=0
CONFIG_SYS_MMC_ENV_PART=0
CONFIG_ENV_SIZE=0x10000

# Boot
CONFIG_BOOTCOMMAND="run load_kernel; run load_fdt; run bootcmd_android"
CONFIG_BOOTDELAY=2

# Distro boot
CONFIG_BOOTDELAY=2
CONFIG_BOOTCOMMAND="run distro_bootcmd"
CONFIG_DISTRO_DEFAULTS="setenv bootargs console=ttymxc0,115200 earlycon root=/dev/mmcblk2p2 rootwait rw"
CONFIG_BOOT_TARGETS="mmc0 usb0 pxe dhcp"

# Android Boot
CONFIG_ANDROID_BOOT_IMAGE=y
CONFIG_ANDROID_BOOT_IMAGE_HASH=y
CONFIG_CMD_ANDROID=y
CONFIG_CMD_BOOTD=y
CONFIG_CMD_BOOTI=y
CONFIG_CMD_BOOTM=y
CONFIG_CMD_BOOTZ=y

# Device Tree
CONFIG_OF_LIBFDT=y
CONFIG_OF_BOARD_SETUP=y
CONFIG_OF_SYSTEM_SETUP=y

# Security
CONFIG_FIT=y
CONFIG_FIT_SIGNATURE=y
CONFIG_RSA=y
CONFIG_SHA256=y

# Commands
CONFIG_CMD_MMC=y
CONFIG_CMD_USB=y
CONFIG_CMD_DHCP=y
CONFIG_CMD_PING=y
CONFIG_CMD_TFTP=y
CONFIG_CMD_FAT=y
CONFIG_CMD_EXT2=y
CONFIG_CMD_FDT=y
CONFIG_CMD_FDT_CONFIG=y
CONFIG_CMD_BOOTZ=y
CONFIG_CMD_BOOTI=y

# Watchdog
CONFIG_HW_WATCHDOG=y
CONFIG_IMX_WATCHDOG=y

# Thermal
CONFIG_THERMAL=y
CONFIG_IMX_THERMAL=y

# PMIC
CONFIG_PMIC_BD71837=y
CONFIG_POWER_BD71837=y

# USB-C / Type-C
CONFIG_TYPEC=y
CONFIG_USB_PD=y
CONFIG_USB_PD_ALT_MODE_DP=y

# Display
CONFIG_VIDEO=y
CONFIG_VIDEO_IMX=y
CONFIG_DRM_IMX=y
CONFIG_DRM_IMX_DISPLAY=y
```

## bootloader/u-boot/configs/meridian_n900_defconfig
```kconfig
# Meridian OS - U-Boot Configuration for Nokia N900 (rx51)
# Based on mainline U-Boot with OMAP3/N900 support

CONFIG_ARM=y
CONFIG_ARCH_OMAP3=y
CONFIG_TARGET_OMAP3_N900=y
CONFIG_SYS_CPU="ARM926EJ-S"
CONFIG_SYS_BOARD="n900"
CONFIG_SYS_SOC="omap3430"
CONFIG_SYS_CONFIG_NAME="n900"

# Boot device
CONFIG_SYS_BOOTDEV="mmc"

# Console
CONFIG_SYS_CONSOLE_INFO_QUIET=y
CONFIG_SYS_CONSOLE_IS_IN_ENV=y
CONFIG_SYS_CONSOLE_OVERWRITE_ROUTINE=y
CONFIG_SYS_CONSOLE_ENV_OVERWRITE=y
CONFIG_SERIAL_TAG=y
CONFIG_CONSOLE_TAG=y

# Memory
CONFIG_SYS_SDRAM_BASE=0x80000000
CONFIG_SYS_SDRAM_SIZE=0x10000000
CONFIG_SYS_MALLOC_LEN=0x1000000
CONFIG_SYS_INIT_SP_ADDR=0x80700000

# NAND/Flash
CONFIG_SYS_NAND_BASE=y
CONFIG_SYS_NAND_BASE_LIST=y
CONFIG_SYS_MAX_NAND_DEVICE=1
CONFIG_NAND_OMAP_GPMC=y
CONFIG_NAND_OMAP_ELM=y
CONFIG_MTD_NAND_OMAP2=y
CONFIG_CMD_NAND=y

# MMC
CONFIG_CMD_MMC=y
CONFIG_MMC_OMAP_HS=y
CONFIG_MMC_OMAP=y
CONFIG_SYS_MMC_ENV_DEV=0
CONFIG_SYS_MMC_ENV_PART=0

# USB
CONFIG_CMD_USB=y
CONFIG_USB_OMAP3=y
CONFIG_USB_EHCI_OMAP=y
CONFIG_USB_EHCI_OMAP3=y
CONFIG_USB_OHCI=y
CONFIG_USB_STORAGE=y
CONFIG_USB_GADGET=y
CONFIG_USB_GADGET_DUALSPEED=y
CONFIG_USB_GADGET_VBUS_DRAW=2
CONFIG_USB_GADGET_SERIAL=y
CONFIG_USB_GADGET_MANUFACTURER="Meridian OS"
CONFIG_USB_GADGET_VENDOR_NUM=0x0421
CONFIG_USB_GADGET_PRODUCT_NUM=0x01c8

# Network
CONFIG_CMD_NET=y
CONFIG_NETDEVICES=y
CONFIG_NETCONSOLE=y
CONFIG_NET_RANDOM_ETHADDR=y
CONFIG_CMD_DHCP=y
CONFIG_CMD_PING=y
CONFIG_CMD_TFTPPUT=y
CONFIG_CMD_TFTPBOOT=y

# Boot
CONFIG_BOOTDELAY=3
CONFIG_BOOTCOMMAND="run findfdt; run init_ostree; run boot_ostree"
CONFIG_BOOTARGS="console=ttyO2,115200 root=OSTREE=/ostree/deploy/meridian.ostree/0 ro quiet splash"

# Environment
CONFIG_ENV_SIZE=0x10000
CONFIG_ENV_OFFSET=0x0
CONFIG_ENV_OFFSET_REDUND=0x10000
CONFIG_ENV_SECT_SIZE=0x20000

# Boot scripts
CONFIG_CMD_BOOTZ=y
CONFIG_CMD_BOOTI=y
CONFIG_CMD_BOOTM=y
CONFIG_CMD_FDT=y
CONFIG_OF_LIBFDT=y
CONFIG_OF_CONTROL=y
CONFIG_OF_STDOUT_VIA_ALIAS=y
CONFIG_OF_BOARD=y
CONFIG_OF_BOARD_SETUP=y

# Device Tree
CONFIG_DEFAULT_DEVICE_TREE="omap3-n900"
CONFIG_OF_EMBED=y

# Bootloader size
CONFIG_SYS_MONITOR_LEN=0x80000
CONFIG_SYS_MONITOR_BASE=0x80000000

# Bootloader commands
CONFIG_CMD_BOOT=y
CONFIG_CMD_GO=y
CONFIG_CMD_RESET=y
CONFIG_CMD_SAVEENV=y
CONFIG_CMD_SETGETDCR=y
CONFIG_CMD_CRC32=y
CONFIG_CMD_CRC=y
CONFIG_CMD_MEMORY=y
CONFIG_CMD_MEMTEST=y
CONFIG_CMD_MISC=y
CONFIG_CMD_PART=y
CONFIG_CMD_FAT=y
CONFIG_CMD_EXT2=y
CONFIG_CMD_EXT4=y
CONFIG_CMD_EXT4_WRITE=y
CONFIG_CMD_FS=y
CONFIG_CMD_MOUNT=y
CONFIG_CMD_UMOUNT=y
CONFIG_CMD_LS=y
CONFIG_CMD_CRC=y
CONFIG_CMD_CRC32=y
CONFIG_CMD_MD5SUM=y
CONFIG_CMD_SHA1SUM=y
CONFIG_CMD_HASH=y
CONFIG_CMD_UNZIP=y
CONFIG_CMD_GZIP=y
CONFIG_CMD_BZIP2=y
CONFIG_CMD_LZMA=y
CONFIG_CMD_LZ4=y
CONFIG_CMD_ZSTD=y

# Security
CONFIG_RSA=y
CONFIG_RSA_N_SIZE=2048
CONFIG_RSA_E=65537
CONFIG_RSA_KEY_SIZE=2048
CONFIG_RSA_E_SIZE=4
CONFIG_RSA_PUBLIC_KEY_SIZE=2048
CONFIG_RSA_PRIVATE_KEY_SIZE=2048
CONFIG_RSA_SIGNATURE_SIZE=2048

# Verified boot
CONFIG_FIT=y
CONFIG_FIT_SIGNATURE=y
CONFIG_FIT_SIGNATURE_RSA=y
CONFIG_FIT_SIGNATURE_RSA2048=y
CONFIG_FIT_SIGNATURE_RSA3072=y
CONFIG_FIT_SIGNATURE_RSA4096=y
CONFIG_FIT_SIGNATURE_ECDSA=y
CONFIG_FIT_SIGNATURE_ECDSA256=y
CONFIG_FIT_SIGNATURE_ECDSA384=y
CONFIG_FIT_SIGNATURE_ECDSA521=y
CONFIG_FIT_SIGNATURE_RSA_KEY_SIZE=2048

# Bootloader integrity
CONFIG_BOOTLOADER_AUTHENTICATION=y
CONFIG_BOOTLOADER_VERIFY=y

# Bootloader version
CONFIG_BOOTLOADER_VERSION="Meridian OS U-Boot"
CONFIG_BOOTLOADER_BUILD_DATE="2026-10-25"
CONFIG_BOOTLOADER_BUILD_TIME="00:00:00"
CONFIG_BOOTLOADER_BUILD_ID="meridian-n900"

# Board specific
CONFIG_OMAP3_N900=y
CONFIG_OMAP3_N900_TPS65950=y
CONFIG_OMAP3_N900_KEYBOARD=y
CONFIG_OMAP3_N900_TVOUT=y
CONFIG_OMAP3_N900_FM=y
CONFIG_OMAP3_N900_USB_OTG=y

# TPS65950 PMIC
CONFIG_TPS65950=y
CONFIG_TPS65950_POWER=y
CONFIG_TPS65950_RTC=y
CONFIG_TPS65950_GPIO=y
CONFIG_TPS65950_LEDS=y

# OMAP3 specific
CONFIG_OMAP3_SRAM=y
CONFIG_OMAP3_GPTIMER=y
CONFIG_OMAP3_WDT=y

# Display
CONFIG_VIDEO_OMAP3_DSS=y
CONFIG_VIDEO_OMAP3_DSS_DPI=y
CONFIG_VIDEO_OMAP3_DSS_RFBI=y
CONFIG_VIDEO_OMAP3_DSS_VENC=y

# MMC
CONFIG_MMC=y
CONFIG_MMC_OMAP=y
CONFIG_MMC_OMAP_HS=y
CONFIG_MMC_SDHCI=y
CONFIG_MMC_SDHCI_OMAP=y

# USB
CONFIG_USB_OMAP3=y
CONFIG_USB_EHCI_OMAP=y
CONFIG_USB_EHCI_OMAP3=y
CONFIG_USB_MUSB_HDRC=y
CONFIG_USB_GADGET=y
CONFIG_USB_GADGET_DUALSPEED=y
CONFIG_USB_GADGET_VBUS_DRAW=2
CONFIG_USB_GADGET_SERIAL=y
CONFIG_USB_GADGET_MANUFACTURER="Meridian OS"
CONFIG_USB_GADGET_VENDOR_NUM=0x0421
CONFIG_USB_GADGET_PRODUCT_NUM=0x01c8

# GPIO
CONFIG_GPIO=y
CONFIG_GPIO_OMAP=y

# I2C
CONFIG_I2C=y
CONFIG_I2C_OMAP=y

# SPI
CONFIG_SPI=y
CONFIG_SPI_OMAP24XX=y

# Power
CONFIG_POWER=y
CONFIG_POWER_RESET=y
CONFIG_POWER_RESET_TPS65950=y
CONFIG_REGULATOR=y
CONFIG_REGULATOR_TPS65950=y

# Clock
CONFIG_CLKDEV_LOOKUP=y
CONFIG_HAVE_CLK=y

# PM
CONFIG_PM=y
CONFIG_PM_SLEEP=y
CONFIG_SUSPEND=y
CONFIG_HIBERNATION=y
CONFIG_PM_RUNTIME=y

# PWM
CONFIG_PWM=y
CONFIG_PWM_TPS65950=y

# RTC
CONFIG_RTC_CLASS=y
CONFIG_RTC_DRV_TPS65950=y

# HSI
CONFIG_HSI=y
CONFIG_HSI_CHAR=m
CONFIG_TI_HSI=y

# SPI
CONFIG_SPI=y
CONFIG_SPI_OMAP24XX=y

# MMC/SD
CONFIG_MMC=y
CONFIG_MMC_BLOCK=y
CONFIG_MMC_BLOCK_BOUNCE=y
CONFIG_MMC_BLOCK_MINORS=8
CONFIG_MMC_SDHCI=y
CONFIG_MMC_SDHCI_OMAP=y
CONFIG_MMC_OMAP=y
CONFIG_MMC_OMAP_HS=y

# USB OTG
CONFIG_USB_OTG=y
CONFIG_USB_OTG_FSM=y
CONFIG_USB_OTG_WHITELIST=y
CONFIG_USB_OTG_BLACKLIST_HUB=y

# USB Host
CONFIG_USB_EHCI_HCD=y
CONFIG_USB_EHCI_ROOT_HUB_TT=y
CONFIG_USB_EHCI_TT_NEWSCHED=y
CONFIG_USB_EHCI_PCI=y
CONFIG_USB_EHCI_HCD_PLATFORM=y
CONFIG_USB_OHCI_HCD=y
CONFIG_USB_OHCI_HCD_PLATFORM=y

# USB Gadget
CONFIG_USB_GADGET=y
CONFIG_USB_GADGET_VBUS_DRAW=2
CONFIG_USB_GADGET_STORAGE_NUM_BUFFERS=2

# USB Serial
CONFIG_USB_SERIAL=y
CONFIG_USB_SERIAL_GENERIC=y
CONFIG_USB_SERIAL_CP210X=y
CONFIG_USB_SERIAL_FTDI_SIO=y
CONFIG_USB_SERIAL_PL2303=y

# USB Network
CONFIG_USB_USBNET=y
CONFIG_USB_NET_CDCETHER=y
CONFIG_USB_NET_CDC_EEM=y
CONFIG_USB_NET_CDC_NCM=y
CONFIG_USB_NET_CDC_MBIM=y
CONFIG_USB_NET_RNDIS_HOST=y
CONFIG_USB_NET_CDC_SUBSET=y
CONFIG_USB_NET_RNDIS_HOST=y

# Network
CONFIG_NET=y
CONFIG_NETDEVICES=y
CONFIG_NETCONSOLE=y
CONFIG_NET_RANDOM_ETHADDR=y
CONFIG_CMD_DHCP=y
CONFIG_CMD_PING=y
CONFIG_CMD_TFTPBOOT=y
CONFIG_CMD_TFTPPUT=y
CONFIG_CMD_NFS=y

# Filesystem
CONFIG_CMD_FAT=y
CONFIG_CMD_EXT2=y
CONFIG_CMD_EXT4=y
CONFIG_CMD_EXT4_WRITE=y
CONFIG_CMD_FS=y
CONFIG_CMD_MOUNT=y
CONFIG_CMD_UMOUNT=y
CONFIG_CMD_LS=y
CONFIG_CMD_CRC=y
CONFIG_CMD_CRC32=y
CONFIG_CMD_MD5SUM=y
CONFIG_CMD_SHA1SUM=y
CONFIG_CMD_HASH=y
CONFIG_CMD_UNZIP=y
CONFIG_CMD_GZIP=y
CONFIG_CMD_BZIP2=y
CONFIG_CMD_LZMA=y
CONFIG_CMD_LZ4=y
CONFIG_CMD_ZSTD=y

# Security
CONFIG_RSA=y
CONFIG_RSA_N_SIZE=2048
CONFIG_RSA_E=65537
CONFIG_RSA_KEY_SIZE=2048
CONFIG_RSA_E_SIZE=4
CONFIG_RSA_PUBLIC_KEY_SIZE=2048
CONFIG_RSA_PRIVATE_KEY_SIZE=2048
CONFIG_RSA_SIGNATURE_SIZE=2048

# Verified boot
CONFIG_FIT=y
CONFIG_FIT_SIGNATURE=y
CONFIG_FIT_SIGNATURE_RSA=y
CONFIG_FIT_SIGNATURE_RSA2048=y
CONFIG_FIT_SIGNATURE_RSA3072=y
CONFIG_FIT_SIGNATURE_RSA4096=y
CONFIG_FIT_SIGNATURE_ECDSA=y
CONFIG_FIT_SIGNATURE_ECDSA256=y
CONFIG_FIT_SIGNATURE_ECDSA384=y
CONFIG_FIT_SIGNATURE_ECDSA521=y
CONFIG_FIT_SIGNATURE_RSA_KEY_SIZE=2048

# Bootloader integrity
CONFIG_BOOTLOADER_AUTHENTICATION=y
CONFIG_BOOTLOADER_VERIFY=y

# Bootloader version
CONFIG_BOOTLOADER_VERSION="Meridian OS U-Boot"
CONFIG_BOOTLOADER_BUILD_DATE="2026-10-25"
CONFIG_BOOTLOADER_BUILD_TIME="00:00:00"
CONFIG_BOOTLOADER_BUILD_ID="meridian-n900"

# Build
CONFIG_SYS_BUILD_DATE="2026-10-25"
CONFIG_SYS_BUILD_TIME="00:00:00"
CONFIG_SYS_BUILD_USER="meridian"
CONFIG_SYS_BUILD_HOST="meridian-os"

# End of config
# MERIDIAN_OS_U_BOOT_CONFIG_N900
```
