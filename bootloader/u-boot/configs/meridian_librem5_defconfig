## kernel/configs/meridian-imx8_defconfig
```kconfig
# Meridian Kernel Config for NXP i.MX8MQ (Librem 5)
# Based on mainline Linux 6.6 LTS with i.MX8MQ support
# Device tree: freescale/imx8mq-librem5.dts

# ARM64 architecture
CONFIG_ARM64=y
CONFIG_64BIT=y
CONFIG_ARM64_PAGE_SHIFT=12
CONFIG_ARM64_VA_BITS=48
CONFIG_ARM64_PA_BITS=48
CONFIG_ARM64_VA_BITS_48=y

# NXP i.MX8MQ SoC support
CONFIG_ARCH_IMX8=y
CONFIG_ARCH_IMX8MQ=y
CONFIG_SOC_IMX8MQ=y
CONFIG_MACH_IMX8MQ_LIBREM5=y
CONFIG_IMX8MQ_GPC=y
CONFIG_IMX8MQ_POWER_DOMAINS=y

# CPU support (4x Cortex-A53)
CONFIG_SMP=y
CONFIG_SMP_ON_UP=y
CONFIG_NR_CPUS=4
CONFIG_HOTPLUG_CPU=y
CONFIG_ARM64_CPU_TOPOLOGY=y
CONFIG_SCHED_MC=y
CONFIG_SCHED_SMT=y

# CPU features
CONFIG_ARM64_SSBD=y
CONFIG_ARM64_PAN=y
CONFIG_ARM64_UAO=y
CONFIG_HAVE_HW_BRKPT=y
CONFIG_HAVE_HW_BRKPT_RESERVED_RW=y

# ARM64 errata
CONFIG_ARM64_ERRATA_819472=y
CONFIG_ARM64_ERRATA_832075=y
CONFIG_ARM64_ERRATA_834220=y
CONFIG_ARM64_ERRATA_843419=y
CONFIG_ARM64_ERRATA_845719=y
CONFIG_ARM64_ERRATA_851948=y
CONFIG_ARM64_ERRATA_852421=y
CONFIG_ARM64_ERRATA_852422=y
CONFIG_ARM64_ERRATA_854240=y
CONFIG_ARM64_ERRATA_854245=y
CONFIG_ARM64_ERRATA_854245_2=y
CONFIG_ARM64_ERRATA_854245_3=y

# Power management
CONFIG_PM=y
CONFIG_PM_SLEEP=y
CONFIG_SUSPEND=y
CONFIG_HIBERNATION=y
CONFIG_PM_RUNTIME=y
CONFIG_PM_OPP=y

# CPU Frequency scaling
CONFIG_CPU_FREQ=y
CONFIG_CPU_FREQ_GOV_ONDEMAND=y
CONFIG_CPU_FREQ_GOV_PERFORMANCE=y
CONFIG_CPU_FREQ_GOV_POWERSAVE=y
CONFIG_CPU_FREQ_GOV_USERSPACE=y
CONFIG_CPU_FREQ_GOV_CONSERVATIVE=y
CONFIG_CPU_FREQ_GOV_SCHEDUTIL=y
CONFIG_CPUFREQ_DT=y
CONFIG_CPUFREQ_DT_PLATDEV=y
CONFIG_ARM_IMX8_CPUFREQ=y

# CPU idle
CONFIG_CPU_IDLE=y
CONFIG_CPU_IDLE_MULTIPLE_DRIVERS=y
CONFIG_CPU_IDLE_GOV_LADDER=y
CONFIG_CPU_IDLE_GOV_MENU=y
CONFIG_CPU_IDLE_GOV_TEO=y
CONFIG_CPU_IDLE_GOV_HALTPOLL=y
CONFIG_ARM_CPUIDLE=y
CONFIG_ARM64_CPUIDLE=y
CONFIG_IMX_CPUIDLE=y

# Thermal
CONFIG_THERMAL=y
CONFIG_THERMAL_HWMON=y
CONFIG_THERMAL_OF=y
CONFIG_THERMAL_DEFAULT_GOV_STEP_WISE=y
CONFIG_THERMAL_GOV_STEP_WISE=y
CONFIG_THERMAL_GOV_POWER_ALLOCATOR=y
CONFIG_THERMAL_EMULATION=y
CONFIG_IMX8MQ_THERMAL=y

# Crypto (ARM64 optimized)
CONFIG_CRYPTO=y
CONFIG_CRYPTO_SHA256=y
CONFIG_CRYPTO_AES=y
CONFIG_CRYPTO_SHA512=y
CONFIG_CRYPTO_AES_ARM64=y
CONFIG_CRYPTO_SHA256_ARM64=y
CONFIG_CRYPTO_SHA512_ARM64=y
CONFIG_CRYPTO_SHA1_ARM64_CE=y
CONFIG_CRYPTO_SHA2_ARM64_CE=y
CONFIG_CRYPTO_CRC32_ARM64_CE=y
CONFIG_CRYPTO_GHASH_ARM64_CE=y
CONFIG_CRYPTO_AES_ARM64_CE_CCM=y
CONFIG_CRYPTO_AES_ARM64_CE_BLK=y
CONFIG_CRYPTO_USER_API_HASH=y
CONFIG_CRYPTO_USER_API_SKCIPHER=y
CONFIG_CRYPTO_USER_API_AEAD=y
CONFIG_CRYPTO_USER_API_RNG=y
CONFIG_CRYPTO_USER_API_AKCIPHER=y

# Device Tree support
CONFIG_OF=y
CONFIG_OF_FLATTREE=y
CONFIG_OF_EARLY_FLATTREE=y
CONFIG_OF_ADDRESS=y
CONFIG_OF_IRQ=y
CONFIG_OF_NET=y
CONFIG_OF_MDIO=y
CONFIG_OF_PCI=y
CONFIG_OF_PCI_IRQ=y
CONFIG_OF_MTD=y

# Boot parameters
CONFIG_CMDLINE="console=ttymxc0,115200 earlycon=ec_imx6q,0x30860000,115200 root=OSTREE=/ostree/deploy/meridian.ostree/0 ro quiet splash plymouth.ignore-serial-consoles"

# Kernel debugging
CONFIG_DEBUG_KERNEL=y
CONFIG_DEBUG_INFO=y
CONFIG_DEBUG_INFO_DWARF5=y
CONFIG_DEBUG_INFO_BTF=y

# Module support
CONFIG_MODULES=y
CONFIG_MODULE_UNLOAD=y
CONFIG_MODVERSIONS=y
CONFIG_MODULE_SRCVERSION_ALL=y

# Compression
CONFIG_KERNEL_GZIP=y
CONFIG_KERNEL_LZ4=y
CONFIG_KERNEL_ZSTD=y

# ARM64 Kernel image
CONFIG_BUILD_ARM64_APPENDED_IMAGE=y
CONFIG_ARM64_APPENDED_DTB_IMAGE_NAMES="fsl-imx8mq-librem5 fsl-imx8mq-librem5-devkit"

# Initramfs
CONFIG_BLK_DEV_INITRD=y
CONFIG_INITRAMFS_SOURCE=""
CONFIG_INITRAMFS_COMPRESSION_GZIP=y
CONFIG_INITRAMFS_COMPRESSION_LZ4=y
CONFIG_INITRAMFS_COMPRESSION_ZSTD=y

# Filesystems
CONFIG_EXT4_FS=y
CONFIG_EXT4_FS_POSIX_ACL=y
CONFIG_EXT4_FS_SECURITY=y
CONFIG_BTRFS_FS=y
CONFIG_F2FS_FS=y
CONFIG_F2FS_STAT_FS=y
CONFIG_F2FS_FS_XATTR=y
CONFIG_F2FS_FS_POSIX_ACL=y
CONFIG_F2FS_FS_SECURITY=y
CONFIG_F2FS_FS_COMPRESSION=y
CONFIG_F2FS_FS_LZO=y
CONFIG_F2FS_FS_LZ4=y
CONFIG_F2FS_FS_ZSTD=y

# Network filesystems
CONFIG_NFS_FS=y
CONFIG_NFS_V3=y
CONFIG_NFS_V4=y
CONFIG_NFS_V4_1=y
CONFIG_NFS_V4_2=y
CONFIG_ROOT_NFS=y

# Pseudo filesystems
CONFIG_PROC_FS=y
CONFIG_PROC_SYSCTL=y
CONFIG_PROC_PAGE_MONITOR=y
CONFIG_KERNFS=y
CONFIG_SYSFS=y
CONFIG_TMPFS=y
CONFIG_TMPFS_POSIX_ACL=y
CONFIG_TMPFS_XATTR=y
CONFIG_CONFIGFS_FS=y
CONFIG_MISC_FILESYSTEMS=y
CONFIG_SQUASHFS=y
CONFIG_SQUASHFS_FILE_DIRECT=y
CONFIG_SQUASHFS_DECOMP_MULTI=y
CONFIG_SQUASHFS_DECOMP_SINGLE=y
CONFIG_SQUASHFS_XATTR=y
CONFIG_SQUASHFS_ZLIB=y
CONFIG_SQUASHFS_LZ4=y
CONFIG_SQUASHFS_LZO=y
CONFIG_SQUASHFS_XZ=y
CONFIG_SQUASHFS_ZSTD=y
CONFIG_SQUASHFS_4K_DEVBLK_SIZE=y
CONFIG_SQUASHFS_EMBEDDED=y
CONFIG_EROFS_FS=y
CONFIG_EROFS_FS_XATTR=y
CONFIG_EROFS_FS_POSIX_ACL=y
CONFIG_EROFS_FS_SECURITY=y
CONFIG_EROFS_FS_COMPRESSION=y
CONFIG_EROFS_FS_ZIP=y
CONFIG_EROFS_FS_LZ4=y

# OSTree support
CONFIG_FS_VERITY=y
CONFIG_FS_VERITY_BUILTIN_SIGNATURES=y

# Security
CONFIG_SECURITY=y
CONFIG_SECURITYFS=y
CONFIG_SECURITY_NETWORK=y
CONFIG_SECURITY_PATH=y
CONFIG_SECURITY_YAMA=y
CONFIG_SECURITY_APPARMOR=y
CONFIG_SECURITY_APPARMOR_HASH=y
CONFIG_SECURITY_APPARMOR_HASH_DEFAULT=y
CONFIG_DEFAULT_SECURITY_APPARMOR=y
CONFIG_DEFAULT_SECURITY="apparmor"

# Hardening
CONFIG_HARDENED_USERCOPY=y
CONFIG_HARDENED_USERCOPY_FALLBACK=y
CONFIG_FORTIFY_SOURCE=y
CONFIG_DEBUG_RODATA=y
CONFIG_DEBUG_SET_MODULE_RONX=y
CONFIG_DEBUG_CREDENTIALS=y
CONFIG_DEBUG_LIST=y
CONFIG_DEBUG_NOTIFIERS=y
CONFIG_DEBUG_LOCK_ALLOC=y
CONFIG_DEBUG_SG=y
CONFIG_DEBUG_VM=y
CONFIG_DEBUG_VIRTUAL=y
CONFIG_DEBUG_PER_CPU_MAPS=y
CONFIG_DEBUG_HIGHMEM=y

# KASAN (Kernel Address Sanitizer)
CONFIG_KASAN=y
CONFIG_KASAN_GENERIC=y
CONFIG_KASAN_INLINE=y

# KCSAN (Kernel Concurrency Sanitizer)
CONFIG_KCSAN=y

# UBSAN (Undefined Behavior Sanitizer)
CONFIG_UBSAN=y
CONFIG_UBSAN_TRAP=y

# Lock debugging
CONFIG_PROVE_LOCKING=y
CONFIG_LOCK_DEBUGGING_SUPPORT=y
CONFIG_LOCK_STAT=y

# RCU debugging
CONFIG_RCU_CPU_STALL_TIMEOUT=60
CONFIG_RCU_CPU_STALL_INFO=y
CONFIG_RCU_TRACE=y

# Function tracing
CONFIG_FUNCTION_TRACER=y
CONFIG_FUNCTION_GRAPH_TRACER=y
CONFIG_DYNAMIC_FTRACE=y
CONFIG_DYNAMIC_FTRACE_WITH_REGS=y
CONFIG_FTRACE_MCOUNT_RECORD=y
CONFIG_FUNCTION_PROFILER=y
CONFIG_STACK_TRACER=y
CONFIG_BLK_DEV_IO_TRACE=y
CONFIG_KPROBES=y
CONFIG_KRETPROBES=y
CONFIG_UPROBES=y

# Early printk
CONFIG_EARLY_PRINTK=y

# KGDB
CONFIG_KGDB=y
CONFIG_KGDB_SERIAL_CONSOLE=y
CONFIG_KGDB_KDB=y
CONFIG_KDB_DEFAULT_ENABLE=0x1

# GPU Drivers (Mainline)
CONFIG_DRM=y
CONFIG_DRM_KMS_HELPER=y
CONFIG_DRM_KMS_FB_HELPER=y
CONFIG_DRM_FBDEV_EMULATION=y
CONFIG_DRM_FBDEV_OVERALLOC=100
CONFIG_DRM_LOAD_EDID_FIRMWARE=y
CONFIG_DRM_DP_CEC=y

# etnaviv (Vivante GC7000Lite - i.MX8MQ GPU)
CONFIG_DRM_ETNAVIV=y

# Panel drivers
CONFIG_DRM_PANEL=y
CONFIG_DRM_PANEL_SIMPLE=y
CONFIG_DRM_PANEL_LT8912=y

# Bridge/HDMI/DP
CONFIG_DRM_BRIDGE=y
CONFIG_DRM_PANEL_BRIDGE=y
CONFIG_DRM_LT8918=y
CONFIG_DRM_ANALOGIX_DP=y
CONFIG_DRM_DW_HDMI=y
CONFIG_DRM_DW_HDMI_AHB_AUDIO=y
CONFIG_DRM_DW_HDMI_I2C_AUDIO=y
CONFIG_DRM_DW_HDMI_CEC=y
CONFIG_DRM_HDMI=y

# Display Engine for i.MX8
CONFIG_DRM_IMX=y
CONFIG_DRM_IMX_DCSS=y
CONFIG_DRM_IMX_HDP=y
CONFIG_DRM_IMX_LDB=y
CONFIG_DRM_IMX_PXP=y
CONFIG_DRM_IMX_SEC=y

# Modem support (BM818/BM818-A1 via USB/QMI)
CONFIG_USB_SERIAL_QUALCOMM=y
CONFIG_USB_QMI_WWAN=y
CONFIG_QRTR=m
CONFIG_QRTR_SMD=m
CONFIG_QRTR_TUN=m
CONFIG_QRTR_MHI=m
CONFIG_MHI_BUS=m
CONFIG_MHI_BUS_PCI_GENERIC=y
CONFIG_MHI_BUS_USB_GENERIC=y
CONFIG_MHI_BUS_QCOM_SMEM=y

# USB Serial (for modem AT/QMI)
CONFIG_USB_SERIAL=y
CONFIG_USB_SERIAL_GENERIC=y
CONFIG_USB_SERIAL_QUALCOMM=y
CONFIG_USB_SERIAL_OPTION=y
CONFIG_USB_SERIAL_WWAN=y

# USB Ethernet/RNDIS/NCM/MBIM
CONFIG_USB_USBNET=y
CONFIG_USB_NET_CDCETHER=y
CONFIG_USB_NET_CDC_EEM=y
CONFIG_USB_NET_CDC_NCM=y
CONFIG_USB_NET_CDC_MBIM=y
CONFIG_USB_NET_QMI_WWAN=y
CONFIG_USB_NET_RNDIS_HOST=y

# Sensors (IIO subsystem)
CONFIG_IIO=y
CONFIG_IIO_BUFFER=y
CONFIG_IIO_BUFFER_CB=y
CONFIG_IIO_BUFFER_HW_CONSUMER=y
CONFIG_IIO_KFIFO_BUF=y
CONFIG_IIO_TRIGGER=y
CONFIG_IIO_TRIGGERED_BUFFER=y
CONFIG_IIO_SYSFS_TRIGGER=y

# ST sensors (LSM6DS3 accelerometer/gyro)
CONFIG_ST_SENSORS_I2C=y
CONFIG_ST_SENSORS_SPI=y
CONFIG_ST_SENSORS_CORE=y
CONFIG_ST_LSM6DSX_I2C=y
CONFIG_ST_LSM6DSX_SPI=y

# ST LIS3MDL magnetometer
CONFIG_ST_LIS3MDL_I2C=y
CONFIG_ST_LIS3MDL_SPI=y

# IIO triggers
CONFIG_IIO_INTERRUPT_TRIGGER=y
CONFIG_IIO_TIGHTLOOP_TRIGGER=y
CONFIG_IIO_SYSFS_TRIGGER=y

# Camera (OV5640 rear, GC2145 front - Librem 5)
CONFIG_VIDEO_V4L2=y
CONFIG_VIDEO_V4L2_SUBDEV_API=y
CONFIG_MEDIA_CAMERA_SUPPORT=y
CONFIG_V4L2_FWNODE=y
CONFIG_MEDIA_CONTROLLER=y
CONFIG_MEDIA_CONTROLLER_REQUEST_API=y
CONFIG_VIDEO_OV5640=y
CONFIG_VIDEO_GC2145=y
CONFIG_VIDEO_V4L2_SUBDEV_USERS=y
CONFIG_VIDEOBUF2_CORE=y
CONFIG_VIDEOBUF2_MEMOPS=y
CONFIG_VIDEOBUF2_DMA_CONTIG=y
CONFIG_VIDEOBUF2_DMA_SG=y
CONFIG_VIDEOBUF2_VMALLOC=y
CONFIG_VIDEOBUF2_V4L2=y
CONFIG_VIDEO_DEV=y
CONFIG_VIDEO_V4L2=y
CONFIG_VIDEO_V4L2_SUBDEV_API=y
CONFIG_VIDEO_V4L2_SUBDEV_USERS=y

# i.MX8 CSI/MIPI
CONFIG_VIDEO_IMX_MEDIA=y
CONFIG_VIDEO_IMX7_MEDIA=y
CONFIG_VIDEO_IMX8_MIPI_CSI2=y

# Audio (ALSA SoC)
CONFIG_SND=y
CONFIG_SND_TIMER=y
CONFIG_SND_PCM=y
CONFIG_SND_PCM_ELD=y
CONFIG_SND_PCM_IEC958=y
CONFIG_SND_DMAENGINE_PCM=y
CONFIG_SND_HWDEP=y
CONFIG_SND_SEQ=y
CONFIG_SND_SEQ_DUMMY=y
CONFIG_SND_SEQ_MIDI=y
CONFIG_SND_RAWMIDI=y
CONFIG_SND_JACK=y
CONFIG_SND_JACK_INPUT_DEV=y
CONFIG_SND_OSSEMUL=y
CONFIG_SND_MIXER_OSS=y
CONFIG_SND_PCM_OSS=y
CONFIG_SND_SEQ_OSS=y

# ALSA SoC
CONFIG_SND_SOC=y
CONFIG_SND_SOC_GENERIC_DMAENGINE_PCM=y
CONFIG_SND_SOC_COMPRESS=y
CONFIG_SND_SOC_TOPOLOGY=y
CONFIG_SND_SOC_ACPI=y

# i.MX8 audio
CONFIG_SND_SOC_IMX=y
CONFIG_SND_SOC_IMX_SAI=y
CONFIG_SND_SOC_IMX_AUDMUX=y
CONFIG_SND_SOC_IMX8=y
CONFIG_SND_SOC_IMX8MQ=y

# Codecs
CONFIG_SND_SOC_WM8962=y
CONFIG_SND_SOC_SIMPLE_CARD=y
CONFIG_SND_SOC_SIMPLE_CARD_UTILS=y

# USB
CONFIG_USB=y
CONFIG_USB_SUPPORT=y
CONFIG_USB_COMMON=y
CONFIG_USB_LEDS_TRIGGER_USBPORT=y
CONFIG_USB_ANNOUNCE_NEW_DEVICES=y
CONFIG_USB_DEFAULT_PERSIST=y
CONFIG_USB_OTG=y
CONFIG_USB_OTG_FSM=y
CONFIG_USB_OTG_WHITELIST=y
CONFIG_USB_OTG_BLACKLIST_HUB=y

# USB Host
CONFIG_USB_XHCI_HCD=y
CONFIG_USB_XHCI_DBGCAP=y
CONFIG_USB_XHCI_PCI=y
CONFIG_USB_XHCI_PLATFORM=y
CONFIG_USB_EHCI_HCD=y
CONFIG_USB_EHCI_ROOT_HUB_TT=y
CONFIG_USB_EHCI_TT_NEWSCHED=y
CONFIG_USB_EHCI_PCI=y
CONFIG_USB_EHCI_HCD_PLATFORM=y
CONFIG_USB_OHCI_HCD=y
CONFIG_USB_OHCI_HCD_PLATFORM=y
CONFIG_USB_UHCI_HCD=y

# USB Gadget
CONFIG_USB_GADGET=y
CONFIG_USB_GADGET_VBUS_DRAW=2
CONFIG_USB_GADGET_STORAGE_NUM_BUFFERS=2
CONFIG_USB_CONFIGFS=y
CONFIG_USB_CONFIGFS_SERIAL=y
CONFIG_USB_CONFIGFS_ACM=y
CONFIG_USB_CONFIGFS_OBEX=y
CONFIG_USB_CONFIGFS_NCM=y
CONFIG_USB_CONFIGFS_ECM=y
CONFIG_USB_CONFIGFS_ECM_SUBSET=y
CONFIG_USB_CONFIGFS_RNDIS=y
CONFIG_USB_CONFIGFS_EEM=y
CONFIG_USB_CONFIGFS_MASS_STORAGE=y
CONFIG_USB_CONFIGFS_F_LB_SS=y
CONFIG_USB_CONFIGFS_F_FS=y
CONFIG_USB_CONFIGFS_F_UAC1=y
CONFIG_USB_CONFIGFS_F_UAC2=y
CONFIG_USB_CONFIGFS_F_MIDI=y
CONFIG_USB_CONFIGFS_F_HID=y
CONFIG_USB_CONFIGFS_F_PRINTER=y
CONFIG_USB_CONFIGFS_F_MTP=y

# i.MX8 USB
CONFIG_USB_IMX=y
CONFIG_USB_IMX8=y
CONFIG_USB_IMX8_DWC3=y
CONFIG_USB_DWC3=y
CONFIG_USB_DWC3_HOST=y
CONFIG_USB_DWC3_GADGET=y
CONFIG_USB_DWC3_OF_SIMPLE=y
CONFIG_USB_DWC3_IMX8=y

# USB Type-C / DisplayPort Alt Mode
CONFIG_TYPEC=y
CONFIG_TYPEC_TCPM=y
CONFIG_TYPEC_TCPCI=y
CONFIG_TYPEC_UCSI=y
CONFIG_UCSI_CCG=y
CONFIG_TYPEC_DP_ALTMODE=y
CONFIG_TYPEC_ROLE_SWITCH=y

# USB PHY
CONFIG_USB_PHY=y
CONFIG_USB_IMX_PHY=y

# MMC/SD
CONFIG_MMC=y
CONFIG_MMC_BLOCK=y
CONFIG_MMC_BLOCK_MINORS=8
CONFIG_MMC_BLOCK_BOUNCE=y
CONFIG_SDIO_UART=y
CONFIG_MMC_SDHCI=y
CONFIG_MMC_SDHCI_IO_ACCESSORS=y
CONFIG_MMC_SDHCI_PLTFM=y
CONFIG_MMC_SDHCI_OF_ARASAN=y
CONFIG_MMC_SDHCI_OF_AT91=y
CONFIG_MMC_SDHCI_OF_DWCMSHC=y
CONFIG_MMC_SDHCI_OF_ESDHC=y
CONFIG_MMC_SDHCI_OF_SUNXI=y
CONFIG_MMC_SDHCI_IMX=y
CONFIG_MMC_SDHCI_ESDHC_IMX=y

# WiFi/BT (RS9116 - SDIO/SPI)
CONFIG_WLAN=y
CONFIG_WLAN_VENDOR_REALTEK=y
CONFIG_WLAN_VENDOR_RSI=y
CONFIG_RSI_91X=y
CONFIG_RSI_SDIO=y
CONFIG_RSI_SPI=y

# Bluetooth
CONFIG_BT=y
CONFIG_BT_BREDR=y
CONFIG_BT_RFCOMM=y
CONFIG_BT_RFCOMM_TTY=y
CONFIG_BT_BNEP=y
CONFIG_BT_BNEP_MC_FILTER=y
CONFIG_BT_BNEP_PROTO_FILTER=y
CONFIG_BT_HIDP=y
CONFIG_BT_HS=y
CONFIG_BT_LE=y
CONFIG_BT_LEDS=y
CONFIG_BT_DEBUGFS=y
CONFIG_BT_HCIBTUSB=y
CONFIG_BT_HCIBTUSB_AUTOSUSPEND=y
CONFIG_BT_HCIBTSDIO=y
CONFIG_BT_HCIUART=y
CONFIG_BT_HCIUART_SERDEV=y
CONFIG_BT_HCIUART_H4=y
CONFIG_BT_HCIUART_BCSP=y
CONFIG_BT_HCIUART_LL=y
CONFIG_BT_HCIUART_3WIRE=y

# I2C
CONFIG_I2C=y
CONFIG_I2C_CHARDEV=y
CONFIG_I2C_MUX=y
CONFIG_I2C_MUX_GPIO=y
CONFIG_I2C_MUX_PCA954x=y
CONFIG_I2C_IMX=y
CONFIG_I2C_IMX_LPI2C=y

# SPI
CONFIG_SPI=y
CONFIG_SPI_MASTER=y
CONFIG_SPI_IMX=y

# GPIO
CONFIG_GPIOLIB=y
CONFIG_GPIO_SYSFS=y
CONFIG_GPIO_IMX=y

# Pin control
CONFIG_PINCTRL=y
CONFIG_PINCTRL_IMX=y
CONFIG_PINCTRL_IMX8MQ=y
CONFIG_PINCTRL_IMX_SCU=y

# Regulator
CONFIG_REGULATOR=y
CONFIG_REGULATOR_FIXED_VOLTAGE=y
CONFIG_REGULATOR_GPIO=y
CONFIG_REGULATOR_BD71837=y

# Power supply
CONFIG_POWER_SUPPLY=y
CONFIG_POWER_RESET=y
CONFIG_POWER_RESET_SYSCON=y
CONFIG_POWER_RESET_IMX=y

# Battery/Charging (BD71837 PMIC)
CONFIG_BATTERY_BD71837=y
CONFIG_CHARGER_BD71837=y
CONFIG_HWMON=y
CONFIG_HWMON_VID=y
CONFIG_SENSORS_BD71837=y

# LED support
CONFIG_LEDS_CLASS=y
CONFIG_LEDS_GPIO=y
CONFIG_LEDS_BD71837=y
CONFIG_LEDS_TRIGGERS=y
CONFIG_LEDS_TRIGGER_TIMER=y
CONFIG_LEDS_TRIGGER_ONESHOT=y
CONFIG_LEDS_TRIGGER_HEARTBEAT=y
CONFIG_LEDS_TRIGGER_BACKLIGHT=y
CONFIG_LEDS_TRIGGER_CPU=y
CONFIG_LEDS_TRIGGER_GPIO=y
CONFIG_LEDS_TRIGGER_DEFAULT_ON=y

# Input
CONFIG_INPUT=y
CONFIG_INPUT_LEDS=y
CONFIG_INPUT_FF_MEMLESS=y
CONFIG_INPUT_POLLDEV=y
CONFIG_INPUT_MATRIXKMAP=y

# Touchscreen (Goodix GT911)
CONFIG_INPUT_TOUCHSCREEN=y
CONFIG_TOUCHSCREEN_GOODIX=y
CONFIG_TOUCHSCREEN_GOODIX_I2C=y

# GPIO Keys (power, volume, kill switches)
CONFIG_INPUT_GPIO_KEYS=y
CONFIG_INPUT_GPIO_DECODER=y
CONFIG_INPUT_GPIO_TILT=y
CONFIG_INPUT_GPIO_VIBRA=y

# Hardware switches (kill switches)
CONFIG_SWITCH=y
CONFIG_SWITCH_GPIO=y

# RTC
CONFIG_RTC_CLASS=y
CONFIG_RTC_DRV_IMX=y
CONFIG_RTC_DRV_BD71837=y

# PWM
CONFIG_PWM=y
CONFIG_PWM_IMX=y
CONFIG_PWM_IMX8MQ=y

# Watchdog
CONFIG_WATCHDOG=y
CONFIG_IMX2_WDT=y

# DMA
CONFIG_DMA_ENGINE=y
CONFIG_DMA_VIRTUAL_CHANNELS=y
CONFIG_DMA_OF=y
CONFIG_DMA_IMX=y
CONFIG_DMA_IMX_SDMA=y

# Clock
CONFIG_CLK_IMX=y
CONFIG_CLK_IMX8MQ=y
CONFIG_CLK_IMX8=y

# Reset
CONFIG_RESET_CONTROLLER=y
CONFIG_RESET_IMX=y

# Pinmux
CONFIG_PINMUX=y

# HWSPINLOCK
CONFIG_HWSPINLOCK=y
CONFIG_HWSPINLOCK_IMX=y

# Interrupt controller
CONFIG_IRQCHIP=y
CONFIG_ARM_GIC=y
CONFIG_ARM_GIC_V2M=y
CONFIG_ARM_GIC_V3=y
CONFIG_ARM_GIC_V3_ITS=y
CONFIG_IMX_GPC=y

# Timer
CONFIG_ARCH_TIMER=y
CONFIG_ARM_ARCH_TIMER=y

# Serial
CONFIG_SERIAL_EARLYCON=y
CONFIG_SERIAL_IMX=y
CONFIG_SERIAL_IMX_CONSOLE=y
CONFIG_SERIAL_IMX_LPUART=y

# Memory
CONFIG_ARM64_64K_PAGES=y
CONFIG_ARM64_VA_BITS_48=y
CONFIG_ARM64_PA_BITS_48=y

# Smartcard reader
CONFIG_SMARTCARD=y
CONFIG_CCID=y

# End marker
# MERIDIAN_OS_KERNEL_CONFIG_IMX8
```
