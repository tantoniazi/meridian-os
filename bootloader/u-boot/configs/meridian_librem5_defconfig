## bootloader/u-boot/configs/meridian_pinephone_defconfig
```kconfig
# Meridian OS - U-Boot Configuration for PinePhone (Allwinner A64/sun50i)
# Based on mainline U-Boot with sun50i-a64 support

CONFIG_ARM64=y
CONFIG_ARCH_SUNXI=y
CONFIG_TARGET_SUN50I_A64_PINEPHONE=y
CONFIG_SYS_CPU="Cortex-A53"
CONFIG_SYS_BOARD="pinephone"
CONFIG_SYS_SOC="sun50i-a64"
CONFIG_SYS_CONFIG_NAME="pinephone"

# Boot device
CONFIG_SYS_BOOTDEV="mmc"

# Console
CONFIG_SYS_CONSOLE_INFO_QUIET=y
CONFIG_SYS_CONSOLE_IS_IN_ENV=y
CONFIG_SYS_CONSOLE_OVERWRITE_ROUTINE=y
CONFIG_SYS_CONSOLE_ENV_OVERWRITE=y
CONFIG_SERIAL_TAG=y
CONFIG_CONSOLE_TAG=y
CONFIG_CONSOLE_SERIAL=y

# Memory
CONFIG_SYS_SDRAM_BASE=0x40000000
CONFIG_SYS_SDRAM_SIZE=0x80000000
CONFIG_SYS_MALLOC_LEN=0x1000000
CONFIG_SYS_INIT_SP_ADDR=0x48000000

# MMC/SD
CONFIG_CMD_MMC=y
CONFIG_MMC_SUNXI=y
CONFIG_SYS_MMC_ENV_DEV=0
CONFIG_SYS_MMC_ENV_PART=0
CONFIG_SYS_MMC_MAX_BLK_COUNT=65535

# USB
CONFIG_CMD_USB=y
CONFIG_USB=y
CONFIG_USB_SUNXI=y
CONFIG_USB_EHCI_HCD=y
CONFIG_USB_EHCI_SUNXI=y
CONFIG_USB_OHCI_HCD=y
CONFIG_USB_OHCI_SUNXI=y
CONFIG_USB_STORAGE=y
CONFIG_USB_GADGET=y
CONFIG_USB_GADGET_DUALSPEED=y
CONFIG_USB_GADGET_VBUS_DRAW=2
CONFIG_USB_GADGET_SERIAL=y
CONFIG_USB_GADGET_MANUFACTURER="Meridian OS"
CONFIG_USB_GADGET_VENDOR_NUM=0x1d6b
CONFIG_USB_GADGET_PRODUCT_NUM=0x0104

# Network
CONFIG_CMD_NET=y
CONFIG_NETDEVICES=y
CONFIG_NETCONSOLE=y
CONFIG_NET_RANDOM_ETHADDR=y
CONFIG_CMD_DHCP=y
CONFIG_CMD_PING=y
CONFIG_CMD_TFTPPUT=y
CONFIG_CMD_TFTPBOOT=y

# Boot
CONFIG_BOOTDELAY=3
CONFIG_BOOTCOMMAND="run findfdt; run init_ostree; run boot_ostree"
CONFIG_BOOTARGS="console=ttyS0,115200 earlycon=sunxi_uart,0x01c28000 root=OSTREE=/ostree/deploy/meridian.ostree/0 ro quiet splash plymouth.ignore-serial-consoles"

# Environment
CONFIG_ENV_SIZE=0x10000
CONFIG_ENV_OFFSET=0x0
CONFIG_ENV_OFFSET_REDUND=0x10000
CONFIG_ENV_SECT_SIZE=0x20000
CONFIG_ENV_IS_IN_MMC=y
CONFIG_SYS_MMC_ENV_DEV=0

# Boot scripts
CONFIG_CMD_BOOTZ=y
CONFIG_CMD_BOOTI=y
CONFIG_CMD_BOOTM=y
CONFIG_CMD_FDT=y
CONFIG_OF_LIBFDT=y
CONFIG_OF_CONTROL=y
CONFIG_OF_STDOUT_VIA_ALIAS=y
CONFIG_OF_BOARD=y
CONFIG_OF_BOARD_SETUP=y

# Device Tree
CONFIG_DEFAULT_DEVICE_TREE="sun50i-a64-pinephone"
CONFIG_OF_EMBED=y

# Bootloader size
CONFIG_SYS_MONITOR_LEN=0x80000
CONFIG_SYS_MONITOR_BASE=0x40000000

# Bootloader commands
CONFIG_CMD_BOOT=y
CONFIG_CMD_GO=y
CONFIG_CMD_RESET=y
CONFIG_CMD_SAVEENV=y
CONFIG_CMD_SETGETDCR=y
CONFIG_CMD_CRC32=y
CONFIG_CMD_CRC=y
CONFIG_CMD_MEMORY=y
CONFIG_CMD_MEMTEST=y
CONFIG_CMD_MISC=y
CONFIG_CMD_PART=y
CONFIG_CMD_FAT=y
CONFIG_CMD_EXT2=y
CONFIG_CMD_EXT4=y
CONFIG_CMD_EXT4_WRITE=y
CONFIG_CMD_FS=y
CONFIG_CMD_MOUNT=y
CONFIG_CMD_UMOUNT=y
CONFIG_CMD_LS=y
CONFIG_CMD_CRC=y
CONFIG_CMD_CRC32=y
CONFIG_CMD_MD5SUM=y
CONFIG_CMD_SHA1SUM=y
CONFIG_CMD_HASH=y
CONFIG_CMD_UNZIP=y
CONFIG_CMD_GZIP=y
CONFIG_CMD_BZIP2=y
CONFIG_CMD_LZMA=y
CONFIG_CMD_LZ4=y
CONFIG_CMD_ZSTD=y

# Security
CONFIG_RSA=y
CONFIG_RSA_N_SIZE=2048
CONFIG_RSA_E=65537
CONFIG_RSA_KEY_SIZE=2048
CONFIG_RSA_E_SIZE=4
CONFIG_RSA_PUBLIC_KEY_SIZE=2048
CONFIG_RSA_PRIVATE_KEY_SIZE=2048
CONFIG_RSA_SIGNATURE_SIZE=2048

# Verified boot
CONFIG_FIT=y
CONFIG_FIT_SIGNATURE=y
CONFIG_FIT_SIGNATURE_RSA=y
CONFIG_FIT_SIGNATURE_RSA2048=y
CONFIG_FIT_SIGNATURE_RSA3072=y
CONFIG_FIT_SIGNATURE_RSA4096=y
CONFIG_FIT_SIGNATURE_ECDSA=y
CONFIG_FIT_SIGNATURE_ECDSA256=y
CONFIG_FIT_SIGNATURE_ECDSA384=y
CONFIG_FIT_SIGNATURE_ECDSA521=y
CONFIG_FIT_SIGNATURE_RSA_KEY_SIZE=2048

# Bootloader integrity
CONFIG_BOOTLOADER_AUTHENTICATION=y
CONFIG_BOOTLOADER_VERIFY=y

# Bootloader version
CONFIG_BOOTLOADER_VERSION="Meridian OS U-Boot"
CONFIG_BOOTLOADER_BUILD_DATE="2026-10-30"
CONFIG_BOOTLOADER_BUILD_TIME="00:00:00"
CONFIG_BOOTLOADER_BUILD_ID="meridian-pinephone"

# Board specific
CONFIG_SUN50I_A64_PINEPHONE=y
CONFIG_SUN50I_A64_PINEPHONE_AXP803=y
CONFIG_SUN50I_A64_PINEPHONE_LCD=y
CONFIG_SUN50I_A64_PINEPHONE_TOUCH=y
CONFIG_SUN50I_A64_PINEPHONE_MODEM=y
CONFIG_SUN50I_A64_PINEPHONE_WIFI=y
CONFIG_SUN50I_A64_PINEPHONE_BT=y
CONFIG_SUN50I_A64_PINEPHONE_CAMERA=y
CONFIG_SUN50I_A64_PINEPHONE_KILL_SWITCHES=y

# AXP803 PMIC
CONFIG_AXP20X=y
CONFIG_AXP803=y
CONFIG_AXP20X_POWER=y
CONFIG_AXP20X_RTC=y
CONFIG_AXP20X_GPIO=y
CONFIG_AXP20X_LEDS=y
CONFIG_AXP20X_REGULATOR=y
CONFIG_AXP20X_FUEL_GAUGE=y

# Allwinner specific
CONFIG_SUNXI_GIC=y
CONFIG_SUNXI_TIMER=y
CONFIG_SUNXI_WDT=y
CONFIG_SUNXI_RTC=y
CONFIG_SUNXI_CCU=y
CONFIG_SUNXI_PRCM=y
CONFIG_SUNXI_PINCTRL=y
CONFIG_SUNXI_DMA=y
CONFIG_SUNXI_EMAC=y

# Display
CONFIG_VIDEO=y
CONFIG_VIDEO_SUNXI=y
CONFIG_VIDEO_SUNXI_DE2=y
CONFIG_VIDEO_SUNXI_TCON=y
CONFIG_VIDEO_SUNXI_HDMI=y
CONFIG_PANEL_SITRONIX_ST7703=y
CONFIG_BACKLIGHT_PWM=y
CONFIG_BACKLIGHT_AXP20X=y

# MMC/SD
CONFIG_MMC=y
CONFIG_MMC_BLOCK=y
CONFIG_MMC_BLOCK_BOUNCE=y
CONFIG_MMC_BLOCK_MINORS=8
CONFIG_MMC_SDHCI=y
CONFIG_MMC_SDHCI_OF_ARASAN=y
CONFIG_MMC_SUNXI=y
CONFIG_MMC_SUNXI_SDHCI=y

# USB
CONFIG_USB_SUNXI_PHY=y
CONFIG_USB_SUNXI_EHCI=y
CONFIG_USB_SUNXI_OHCI=y
CONFIG_USB_OTG=y
CONFIG_USB_OTG_FSM=y
CONFIG_USB_OTG_WHITELIST=y
CONFIG_USB_OTG_BLACKLIST_HUB=y

# USB Host
CONFIG_USB_EHCI_HCD=y
CONFIG_USB_EHCI_ROOT_HUB_TT=y
CONFIG_USB_EHCI_TT_NEWSCHED=y
CONFIG_USB_EHCI_HCD_PLATFORM=y
CONFIG_USB_OHCI_HCD=y
CONFIG_USB_OHCI_HCD_PLATFORM=y

# USB Gadget
CONFIG_USB_GADGET=y
CONFIG_USB_GADGET_VBUS_DRAW=2
CONFIG_USB_GADGET_STORAGE_NUM_BUFFERS=2
CONFIG_USB_GADGET_CONFIGFS=y
CONFIG_USB_GADGET_CONFIGFS_SERIAL=y
CONFIG_USB_GADGET_CONFIGFS_ACM=y
CONFIG_USB_GADGET_CONFIGFS_ECM=y
CONFIG_USB_GADGET_CONFIGFS_ECM_SUBSET=y
CONFIG_USB_GADGET_CONFIGFS_RNDIS=y
CONFIG_USB_GADGET_CONFIGFS_EEM=y
CONFIG_USB_GADGET_CONFIGFS_MASS_STORAGE=y

# GPIO
CONFIG_GPIO=y
CONFIG_GPIO_SUNXI=y

# I2C
CONFIG_I2C=y
CONFIG_I2C_SUNXI=y
CONFIG_I2C_SUNXI_PM=y

# SPI
CONFIG_SPI=y
CONFIG_SPI_SUNXI=y
CONFIG_SPI_SUN6I=y

# Power
CONFIG_POWER=y
CONFIG_POWER_RESET=y
CONFIG_POWER_RESET_SUNXI=y
CONFIG_POWER_RESET_AXP20X=y
CONFIG_REGULATOR=y
CONFIG_REGULATOR_AXP20X=y
CONFIG_REGULATOR_AXP803=y
CONFIG_REGULATOR_AXP805=y
CONFIG_REGULATOR_FIXED_VOLTAGE=y
CONFIG_REGULATOR_GPIO=y

# Clock
CONFIG_CLKDEV_LOOKUP=y
CONFIG_HAVE_CLK=y
CONFIG_CLK_SUNXI=y
CONFIG_CLK_SUNXI_PRCM_SUN50I_A64=y
CONFIG_CLK_SUNXI_PRCM_SUN50I_A64_R=y

# PM
CONFIG_PM=y
CONFIG_PM_SLEEP=y
CONFIG_SUSPEND=y
CONFIG_HIBERNATION=y
CONFIG_PM_RUNTIME=y

# PWM
CONFIG_PWM=y
CONFIG_PWM_SUNXI=y
CONFIG_PWM_SUN4I=y

# RTC
CONFIG_RTC_CLASS=y
CONFIG_RTC_DRV_SUNXI=y
CONFIG_RTC_DRV_AXP20X=y

# HSI
CONFIG_HSI=y

# Bootloader version
CONFIG_SYS_BUILD_DATE="2026-10-30"
CONFIG_SYS_BUILD_TIME="00:00:00"
CONFIG_SYS_BUILD_USER="meridian"
CONFIG_SYS_BUILD_HOST="meridian-os"

# End of config
# MERIDIAN_OS_U_BOOT_CONFIG_PINEPHONE
```
