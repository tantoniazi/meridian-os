## kernel/configs/meridian-omap3_defconfig
```kconfig
# Meridian Kernel Config for OMAP3 (N900/N9/N950)
# Based on mainline 6.6 LTS with OMAP3 specific support

CONFIG_ARCH_OMAP3=y
CONFIG_MACH_OMAP3_N900=y
CONFIG_MACH_OMAP3_N9=y
CONFIG_MACH_OMAP3_N950=y
CONFIG_SOC_OMAP3430=y
CONFIG_OMAP3_EMU=y

# Mainline GPU (reverse-engineered PowerVR SGX)
CONFIG_DRM_OMAP3=y
CONFIG_DRM_PVR_OMAP3=m

# Modem HSI (High-Speed Synchronous Serial Interface)
CONFIG_HSI=y
CONFIG_HSI_CHAR=m
CONFIG_TI_HSI=y

# Sensors (IIO subsystem)
CONFIG_IIO=y
CONFIG_SENSORS_LIS331=y
CONFIG_SENSORS_HMC5843=y
CONFIG_SENSORS_L3G4200D=y

# Camera (OMAP3 ISP + sensors)
CONFIG_VIDEO_OMAP3_CAMERA=y
CONFIG_VIDEO_MT9T111=y
CONFIG_VIDEO_MT9T112=y

# Audio (TPS65950/TWL4030 codecs)
CONFIG_SND_SOC_TPS65950=y
CONFIG_SND_SOC_TWL4030=y

# USB OTG (musb)
CONFIG_USB_OTG=y
CONFIG_USB_MUSB_HDRC=y
CONFIG_USB_TUSB6010=y

# Power Management (TPS65950 PMIC)
CONFIG_POWER_RESET_TPS65950=y
CONFIG_REGULATOR_TPS65950=y
CONFIG_TPS65950_POWER=y

# MMC/SD (OMAP HS MMC)
CONFIG_MMC_OMAP_HS=y
CONFIG_MMC_SDHCI_OMAP=y

# Display (OMAP DSS)
CONFIG_OMAP2_DSS=y
CONFIG_OMAP2_DSS_DPI=y
CONFIG_OMAP2_DSS_RFBI=y
CONFIG_OMAP2_DSS_VENC=y
CONFIG_OMAP4_DSS=y

# LED support (N900 keyboard backlight, etc.)
CONFIG_LEDS_CLASS=y
CONFIG_LEDS_GPIO=y
CONFIG_LEDS_TPS65950=y

# Input (N900 keyboard, touchscreen)
CONFIG_KEYBOARD_GPIO=y
CONFIG_KEYBOARD_TPS65950=y
CONFIG_TOUCHSCREEN_TPS65950=y

# MMC/SD card
CONFIG_MMC=y
CONFIG_MMC_BLOCK=y
CONFIG_MMC_OMAP_HS=y
CONFIG_MMC_SDHCI=y
CONFIG_MMC_SDHCI_OMAP=y

# USB (musb-hdrc for OTG)
CONFIG_USB_MUSB_HDRC=y
CONFIG_USB_TUSB6010=y
CONFIG_USB_GADGET=y
CONFIG_USB_ETH=y
CONFIG_USB_ETH_RNDIS=y

# OMAP specific
CONFIG_ARCH_OMAP3=y
CONFIG_SOC_OMAP3430=y
CONFIG_OMAP3_EMU=y
CONFIG_OMAP_PACKAGE_CBB=y
CONFIG_OMAP_PACKAGE_CUS=y

# DMA
CONFIG_OMAP_DMA=y

# Clock framework
CONFIG_CLKDEV_LOOKUP=y
CONFIG_HAVE_CLK=y

# GPIO
CONFIG_GPIOLIB=y
CONFIG_GPIO_SYSFS=y

# I2C
CONFIG_I2C=y
CONFIG_I2C_OMAP=y

# SPI
CONFIG_SPI=y
CONFIG_SPI_OMAP24XX=y

# Watchdog
CONFIG_WATCHDOG=y
CONFIG_OMAP_WATCHDOG=y

# RTC
CONFIG_RTC_CLASS=y
CONFIG_RTC_DRV_TPS65950=y

# Power Management
CONFIG_PM=y
CONFIG_PM_SLEEP=y
CONFIG_SUSPEND=y
CONFIG_HIBERNATION=y
CONFIG_PM_RUNTIME=y
CONFIG_PM_OPP=y

# CPU Frequency scaling
CONFIG_CPU_FREQ=y
CONFIG_CPU_FREQ_GOV_ONDEMAND=y
CONFIG_CPU_FREQ_GOV_PERFORMANCE=y
CONFIG_CPU_FREQ_GOV_POWERSAVE=y
CONFIG_CPU_FREQ_GOV_USERSPACE=y
CONFIG_CPU_FREQ_GOV_CONSERVATIVE=y
CONFIG_CPU_FREQ_GOV_SCHEDUTIL=y
CONFIG_CPUFREQ_DT=y
CONFIG_CPUFREQ_DT_PLATDEV=y

# Thermal
CONFIG_THERMAL=y
CONFIG_THERMAL_HWMON=y
CONFIG_THERMAL_OF=y
CONFIG_THERMAL_DEFAULT_GOV_STEP_WISE=y

# Crypto (for dm-verity, etc.)
CONFIG_CRYPTO=y
CONFIG_CRYPTO_SHA256=y
CONFIG_CRYPTO_AES=y
CONFIG_CRYPTO_USER_API_HASH=y
CONFIG_CRYPTO_USER_API_SKCIPHER=y

# Device Tree support
CONFIG_OF=y
CONFIG_OF_FLATTREE=y
CONFIG_OF_EARLY_FLATTREE=y
CONFIG_OF_ADDRESS=y
CONFIG_OF_IRQ=y
CONFIG_OF_NET=y
CONFIG_OF_MDIO=y
CONFIG_OF_PCI=y
CONFIG_OF_PCI_IRQ=y
CONFIG_OF_MTD=y

# Boot parameters
CONFIG_CMDLINE="console=ttyO2,115200 root=OSTREE=/ostree/deploy/meridian.ostree/0 ro quiet splash"

# Kernel debugging
CONFIG_DEBUG_KERNEL=y
CONFIG_DEBUG_INFO=y
CONFIG_DEBUG_INFO_DWARF5=y
CONFIG_DEBUG_INFO_BTF=y

# Module support
CONFIG_MODULES=y
CONFIG_MODULE_UNLOAD=y
CONFIG_MODVERSIONS=y
CONFIG_MODULE_SRCVERSION_ALL=y

# Compression
CONFIG_KERNEL_GZIP=y
CONFIG_KERNEL_LZ4=y
CONFIG_KERNEL_ZSTD=y

# Kernel image type (ARM)
CONFIG_ZBOOT_ROM_TEXT=0
CONFIG_ZBOOT_ROM_BSS=0
CONFIG_ZBOOT_ROM=y

# Initramfs
CONFIG_BLK_DEV_INITRD=y
CONFIG_INITRAMFS_SOURCE=""
CONFIG_INITRAMFS_COMPRESSION_GZIP=y
CONFIG_INITRAMFS_COMPRESSION_LZ4=y
CONFIG_INITRAMFS_COMPRESSION_ZSTD=y

# Filesystems
CONFIG_EXT4_FS=y
CONFIG_EXT4_FS_POSIX_ACL=y
CONFIG_EXT4_FS_SECURITY=y
CONFIG_BTRFS_FS=y
CONFIG_F2FS_FS=y
CONFIG_F2FS_STAT_FS=y
CONFIG_F2FS_FS_XATTR=y
CONFIG_F2FS_FS_POSIX_ACL=y
CONFIG_F2FS_FS_SECURITY=y
CONFIG_F2FS_FS_COMPRESSION=y
CONFIG_F2FS_FS_LZO=y
CONFIG_F2FS_FS_LZ4=y
CONFIG_F2FS_FS_ZSTD=y

# Network filesystems
CONFIG_NFS_FS=y
CONFIG_NFS_V3=y
CONFIG_NFS_V4=y
CONFIG_NFS_V4_1=y
CONFIG_NFS_V4_2=y
CONFIG_ROOT_NFS=y

# Pseudo filesystems
CONFIG_PROC_FS=y
CONFIG_PROC_SYSCTL=y
CONFIG_PROC_PAGE_MONITOR=y
CONFIG_KERNFS=y
CONFIG_SYSFS=y
CONFIG_TMPFS=y
CONFIG_TMPFS_POSIX_ACL=y
CONFIG_TMPFS_XATTR=y
CONFIG_CONFIGFS_FS=y
CONFIG_MISC_FILESYSTEMS=y
CONFIG_SQUASHFS=y
CONFIG_SQUASHFS_FILE_DIRECT=y
CONFIG_SQUASHFS_DECOMP_MULTI=y
CONFIG_SQUASHFS_DECOMP_SINGLE=y
CONFIG_SQUASHFS_XATTR=y
CONFIG_SQUASHFS_ZLIB=y
CONFIG_SQUASHFS_LZ4=y
CONFIG_SQUASHFS_LZO=y
CONFIG_SQUASHFS_XZ=y
CONFIG_SQUASHFS_ZSTD=y
CONFIG_SQUASHFS_4K_DEVBLK_SIZE=y
CONFIG_SQUASHFS_EMBEDDED=y
CONFIG_EROFS_FS=y
CONFIG_EROFS_FS_XATTR=y
CONFIG_EROFS_FS_POSIX_ACL=y
CONFIG_EROFS_FS_SECURITY=y
CONFIG_EROFS_FS_COMPRESSION=y
CONFIG_EROFS_FS_ZIP=y
CONFIG_EROFS_FS_LZ4=y

# OSTree support
CONFIG_FS_VERITY=y
CONFIG_FS_VERITY_BUILTIN_SIGNATURES=y

# Security
CONFIG_SECURITY=y
CONFIG_SECURITYFS=y
CONFIG_SECURITY_NETWORK=y
CONFIG_SECURITY_PATH=y
CONFIG_SECURITY_YAMA=y
CONFIG_SECURITY_APPARMOR=y
CONFIG_SECURITY_APPARMOR_HASH=y
CONFIG_SECURITY_APPARMOR_HASH_DEFAULT=y
CONFIG_DEFAULT_SECURITY_APPARMOR=y
CONFIG_DEFAULT_SECURITY="apparmor"

# Hardening
CONFIG_HARDENED_USERCOPY=y
CONFIG_HARDENED_USERCOPY_FALLBACK=y
CONFIG_FORTIFY_SOURCE=y
CONFIG_DEBUG_RODATA=y
CONFIG_DEBUG_SET_MODULE_RONX=y
CONFIG_DEBUG_CREDENTIALS=y
CONFIG_DEBUG_LIST=y
CONFIG_DEBUG_NOTIFIERS=y
CONFIG_DEBUG_LOCK_ALLOC=y
CONFIG_DEBUG_SG=y
CONFIG_DEBUG_VM=y
CONFIG_DEBUG_VIRTUAL=y
CONFIG_DEBUG_PER_CPU_MAPS=y
CONFIG_DEBUG_HIGHMEM=y

# KASAN (Kernel Address Sanitizer)
CONFIG_KASAN=y
CONFIG_KASAN_GENERIC=y
CONFIG_KASAN_INLINE=y

# KCSAN (Kernel Concurrency Sanitizer)
CONFIG_KCSAN=y

# UBSAN (Undefined Behavior Sanitizer)
CONFIG_UBSAN=y
CONFIG_UBSAN_TRAP=y

# Lock debugging
CONFIG_PROVE_LOCKING=y
CONFIG_LOCK_DEBUGGING_SUPPORT=y
CONFIG_LOCK_STAT=y

# RCU debugging
CONFIG_RCU_CPU_STALL_TIMEOUT=60
CONFIG_RCU_CPU_STALL_INFO=y
CONFIG_RCU_TRACE=y

# Function tracing
CONFIG_FUNCTION_TRACER=y
CONFIG_FUNCTION_GRAPH_TRACER=y
CONFIG_DYNAMIC_FTRACE=y
CONFIG_DYNAMIC_FTRACE_WITH_REGS=y
CONFIG_FTRACE_MCOUNT_RECORD=y
CONFIG_FUNCTION_PROFILER=y
CONFIG_STACK_TRACER=y
CONFIG_BLK_DEV_IO_TRACE=y
CONFIG_KPROBES=y
CONFIG_KRETPROBES=y
CONFIG_UPROBES=y

# Early printk
CONFIG_EARLY_PRINTK=y

# KGDB
CONFIG_KGDB=y
CONFIG_KGDB_SERIAL_CONSOLE=y
CONFIG_KGDB_KDB=y
CONFIG_KDB_DEFAULT_ENABLE=0x1

# ARM specific
CONFIG_ARM=y
CONFIG_ARM_HAS_SG_CHAIN=y
CONFIG_SYS_SUPPORTS_APM_EMULATION=y
CONFIG_HAVE_PROC_CPU=y
CONFIG_STACKTRACE_SUPPORT=y
CONFIG_LOCKDEP_SUPPORT=y
CONFIG_TRACE_IRQFLAGS_SUPPORT=y
CONFIG_RWSEM_XCHGADD_ALGORITHM=y
CONFIG_GENERIC_HWEIGHT=y
CONFIG_GENERIC_CALIBRATE_DELAY=y
CONFIG_GENERIC_CSUM=y
CONFIG_GENERIC_CLOCKEVENTS=y
CONFIG_GENERIC_CLOCKEVENTS_BROADCAST=y
CONFIG_GENERIC_IRQ_PROBE=y
CONFIG_GENERIC_IRQ_SHOW=y
CONFIG_GENERIC_IRQ_SHOW_LEVEL=y
CONFIG_HARDIRQS_SW_RESEND=y
CONFIG_GENERIC_IRQ_CHIP=y
CONFIG_IRQ_DOMAIN=y
CONFIG_IRQ_DOMAIN_HIERARCHY=y
CONFIG_HANDLE_DOMAIN_IRQ=y
CONFIG_IRQ_FORCED_THREADING=y
CONFIG_SPARSE_IRQ=y
CONFIG_CLOCKSOURCE_WATCHDOG=y
CONFIG_ARCH_CLOCKSOURCE_DATA=y
CONFIG_GENERIC_TIME_VSYSCALL=y
CONFIG_GENERIC_CLOCKEVENTS=y
CONFIG_ARCH_HAS_TICK_BROADCAST=y
CONFIG_GENERIC_CLOCKEVENTS_BROADCAST=y
CONFIG_TICK_ONESHOT=y
CONFIG_NO_HZ_COMMON=y
CONFIG_NO_HZ_IDLE=y
CONFIG_NO_HZ=y
CONFIG_HIGH_RES_TIMERS=y

# SMP
CONFIG_SMP=y
CONFIG_SMP_ON_UP=y
CONFIG_ARM_CPU_TOPOLOGY=y
CONFIG_SCHED_MC=y
CONFIG_SCHED_SMT=y
CONFIG_NR_CPUS=2
CONFIG_HOTPLUG_CPU=y

# ARM errata
CONFIG_ARM_ERRATA_430973=y
CONFIG_ARM_ERRATA_458693=y
CONFIG_ARM_ERRATA_460075=y
CONFIG_ARM_ERRATA_742230=y
CONFIG_ARM_ERRATA_743622=y
CONFIG_ARM_ERRATA_751472=y
CONFIG_ARM_ERRATA_753970=y
CONFIG_ARM_ERRATA_754322=y
CONFIG_ARM_ERRATA_754327=y
CONFIG_ARM_ERRATA_764369=y
CONFIG_ARM_ERRATA_773022=y
CONFIG_ARM_ERRATA_775420=y
CONFIG_ARM_ERRATA_798181=y
CONFIG_ARM_ERRATA_798237=y
CONFIG_ARM_ERRATA_818325_852421=y
CONFIG_ARM_ERRATA_821420=y
CONFIG_ARM_ERRATA_825619=y
CONFIG_ARM_ERRATA_827319=y
CONFIG_ARM_ERRATA_828012=y
CONFIG_ARM_ERRATA_831655=y
CONFIG_ARM_ERRATA_834220=y
CONFIG_ARM_ERRATA_835761=y
CONFIG_ARM_ERRATA_837630=y
CONFIG_ARM_ERRATA_845719=y
CONFIG_ARM_ERRATA_849769=y
CONFIG_ARM_ERRATA_851948=y
CONFIG_ARM_ERRATA_852422=y
CONFIG_ARM_ERRATA_852423=y
CONFIG_ARM_ERRATA_854134=y
CONFIG_ARM_ERRATA_854240=y
CONFIG_ARM_ERRATA_854245=y
CONFIG_ARM_ERRATA_854251=y
CONFIG_ARM_ERRATA_854252=y
CONFIG_ARM_ERRATA_854253=y
CONFIG_ARM_ERRATA_854254=y
CONFIG_ARM_ERRATA_854255=y
CONFIG_ARM_ERRATA_854256=y
CONFIG_ARM_ERRATA_854257=y
CONFIG_ARM_ERRATA_854258=y
CONFIG_ARM_ERRATA_854259=y
CONFIG_ARM_ERRATA_854260=y
CONFIG_ARM_ERRATA_854261=y
CONFIG_ARM_ERRATA_854262=y
CONFIG_ARM_ERRATA_854263=y
CONFIG_ARM_ERRATA_854264=y
CONFIG_ARM_ERRATA_854265=y
CONFIG_ARM_ERRATA_854266=y
CONFIG_ARM_ERRATA_854267=y
CONFIG_ARM_ERRATA_854268=y
CONFIG_ARM_ERRATA_854269=y
CONFIG_ARM_ERRATA_854270=y
CONFIG_ARM_ERRATA_854271=y
CONFIG_ARM_ERRATA_854272=y
CONFIG_ARM_ERRATA_854273=y
CONFIG_ARM_ERRATA_854274=y
CONFIG_ARM_ERRATA_854275=y
CONFIG_ARM_ERRATA_854276=y
CONFIG_ARM_ERRATA_854277=y
CONFIG_ARM_ERRATA_854278=y
CONFIG_ARM_ERRATA_854279=y
CONFIG_ARM_ERRATA_854280=y
CONFIG_ARM_ERRATA_854281=y
CONFIG_ARM_ERRATA_854282=y
CONFIG_ARM_ERRATA_854283=y
CONFIG_ARM_ERRATA_854284=y
CONFIG_ARM_ERRATA_854285=y
CONFIG_ARM_ERRATA_854286=y
CONFIG_ARM_ERRATA_854287=y
CONFIG_ARM_ERRATA_854288=y
CONFIG_ARM_ERRATA_854289=y
CONFIG_ARM_ERRATA_854290=y
CONFIG_ARM_ERRATA_854291=y
CONFIG_ARM_ERRATA_854292=y
CONFIG_ARM_ERRATA_854293=y
CONFIG_ARM_ERRATA_854294=y
CONFIG_ARM_ERRATA_854295=y
CONFIG_ARM_ERRATA_854296=y
CONFIG_ARM_ERRATA_854297=y
CONFIG_ARM_ERRATA_854298=y
CONFIG_ARM_ERRATA_854299=y
CONFIG_ARM_ERRATA_854300=y
CONFIG_ARM_ERRATA_854301=y
CONFIG_ARM_ERRATA_854302=y
CONFIG_ARM_ERRATA_854303=y
CONFIG_ARM_ERRATA_854304=y
CONFIG_ARM_ERRATA_854305=y
CONFIG_ARM_ERRATA_854306=y
CONFIG_ARM_ERRATA_854307=y
CONFIG_ARM_ERRATA_854308=y
CONFIG_ARM_ERRATA_854309=y
CONFIG_ARM_ERRATA_854310=y
CONFIG_ARM_ERRATA_854311=y
CONFIG_ARM_ERRATA_854312=y
CONFIG_ARM_ERRATA_854313=y
CONFIG_ARM_ERRATA_854314=y
CONFIG_ARM_ERRATA_854315=y
CONFIG_ARM_ERRATA_854316=y
CONFIG_ARM_ERRATA_854317=y
CONFIG_ARM_ERRATA_854318=y
CONFIG_ARM_ERRATA_854319=y
CONFIG_ARM_ERRATA_854320=y
CONFIG_ARM_ERRATA_854321=y
CONFIG_ARM_ERRATA_854322=y
CONFIG_ARM_ERRATA_854323=y
CONFIG_ARM_ERRATA_854324=y
CONFIG_ARM_ERRATA_854325=y
CONFIG_ARM_ERRATA_854326=y
CONFIG_ARM_ERRATA_854327=y
CONFIG_ARM_ERRATA_854328=y
CONFIG_ARM_ERRATA_854329=y
CONFIG_ARM_ERRATA_854330=y
CONFIG_ARM_ERRATA_854331=y
CONFIG_ARM_ERRATA_854332=y
CONFIG_ARM_ERRATA_854333=y
CONFIG_ARM_ERRATA_854334=y
CONFIG_ARM_ERRATA_854334=y
CONFIG_ARM_ERRATA_854336=y
CONFIG_ARM_ERRATA_854337=y
CONFIG_ARM_ERRATA_854338=y
CONFIG_ARM_ERRATA_854339=y
CONFIG_ARM_ERRATA_854340=y
CONFIG_ARM_ERRATA_854341=y
CONFIG_ARM_ERRATA_854342=y
CONFIG_ARM_ERRATA_854343=y
CONFIG_ARM_ERRATA_854344=y
CONFIG_ARM_ERRATA_854345=y
CONFIG_ARM_ERRATA_854346=y
CONFIG_ARM_ERRATA_854347=y
CONFIG_ARM_ERRATA_854348=y
CONFIG_ARM_ERRATA_854349=y
CONFIG_ARM_ERRATA_854350=y
CONFIG_ARM_ERRATA_854351=y
CONFIG_ARM_ERRATA_854352=y
CONFIG_ARM_ERRATA_854353=y
CONFIG_ARM_ERRATA_854354=y
CONFIG_ARM_ERRATA_854355=y
CONFIG_ARM_ERRATA_854356=y
CONFIG_ARM_ERRATA_854357=y
CONFIG_ARM_ERRATA_854358=y
CONFIG_ARM_ERRATA_854359=y
CONFIG_ARM_ERRATA_854360=y
CONFIG_ARM_ERRATA_854361=y
CONFIG_ARM_ERRATA_854362=y
CONFIG_ARM_ERRATA_854363=y
CONFIG_ARM_ERRATA_854364=y
CONFIG_ARM_ERRATA_854365=y
CONFIG_ARM_ERRATA_854366=y
CONFIG_ARM_ERRATA_854367=y
CONFIG_ARM_ERRATA_854368=y
CONFIG_ARM_ERRATA_854369=y
CONFIG_ARM_ERRATA_854370=y
CONFIG_ARM_ERRATA_854371=y
CONFIG_ARM_ERRATA_854372=y
CONFIG_ARM_ERRATA_854373=y
CONFIG_ARM_ERRATA_854374=y
CONFIG_ARM_ERRATA_854375=y
CONFIG_ARM_ERRATA_854376=y
CONFIG_ARM_ERRATA_854377=y
CONFIG_ARM_ERRATA_854378=y
CONFIG_ARM_ERRATA_854379=y
CONFIG_ARM_ERRATA_854380=y
CONFIG_ARM_ERRATA_854381=y
CONFIG_ARM_ERRATA_854382=y
CONFIG_ARM_ERRATA_854383=y
CONFIG_ARM_ERRATA_854384=y
CONFIG_ARM_ERRATA_854385=y
CONFIG_ARM_ERRATA_854386=y
CONFIG_ARM_ERRATA_854387=y
CONFIG_ARM_ERRATA_854388=y
CONFIG_ARM_ERRATA_854389=y
CONFIG_ARM_ERRATA_854390=y
CONFIG_ARM_ERRATA_854391=y
CONFIG_ARM_ERRATA_854392=y
CONFIG_ARM_ERRATA_854393=y
CONFIG_ARM_ERRATA_854394=y
CONFIG_ARM_ERRATA_854395=y
CONFIG_ARM_ERRATA_854396=y
CONFIG_ARM_ERRATA_854397=y
CONFIG_ARM_ERRATA_854398=y
CONFIG_ARM_ERRATA_854399=y
CONFIG_ARM_ERRATA_854400=y

# end of auto-generated config
# MERIDIAN_OS_KERNEL_CONFIG_OMAP3
```
